## examples/minimal/sdkconfig.defaults
```kconfig
# Minimal SDKCONFIG for M0 example
CONFIG_LOG_DEFAULT_LEVEL_NONE=y
CONFIG_LOG_MAXIMUM_LEVEL=0
CONFIG_BOOTLOADER_APP_ANTI_ROLLBACK=n
CONBOOTLOADER_LOG_LEVEL_NONE=y
```

## examples/minimal_body/main/Kconfig.projbuild
```kconfig
menu "NeonDoll example"
    config NEONDOLL_WIFI_ENABLE
        bool "Enable M2.1 Wi-Fi station example"
        default n
        help
            Start Wi-Fi after persistent identity initialization succeeds.
            Leave disabled for identity-only testing and QEMU.
    config NEONDOLL_WIFI_SSID
        string "Wi-Fi SSID"
        depends on NEONDOLL_WIFI_ENABLE
        default ""
    config NEONDOLL_WIFI_PASSWORD
        string "Wi-Fi password (empty for open AP)"
        depends on NEONDOLL_WIFI_ENABLE
        default ""
endmenu
```

## integration/wireguard_ipv6/esp32/sdkconfig.defaults
```kconfig
CONFIG_IDF_TARGET="esp32"
CONFIG_LWIP_IPV6=y
CONFIG_LWIP_PPP_SUPPORT=y
CONFIG_LWIP_TCPIP_CORE_LOCKING=y
```
